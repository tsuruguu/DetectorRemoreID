## build/hci_ipc/Kconfig/Kconfig.shield
```kconfig
osource "/Users/dobrawa/Documents/hacknarok/nrf/boards/shields/*/Kconfig.shield"
```

## build/hci_ipc/Kconfig/Kconfig.shield.defconfig
```kconfig
osource "/Users/dobrawa/Documents/hacknarok/nrf/boards/shields/*/Kconfig.defconfig"
```
